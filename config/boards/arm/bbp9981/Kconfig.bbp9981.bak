## config/boards/arm/bbp9981/Kconfig.bbp9981.bak
```kconfig
# Copyright (c) 2025 ZitaoTech
# SPDX-License-Identifier: MIT

config BOARD_BBP9981
    bool "bbp9981"
    depends on SOC_NRF52840_QIAA
```

## config/boards/arm/bbp9981/dts/bindings/one-cell.yaml
```yaml
# Copyright (c) 2024 The ZMK Contributors
# SPDX-License-Identifier: MIT

description: |
  Base for behaviors that take one cell parameter

properties:
  "#binding-cells":
    type: int
    const: 1
```

## config/boards/arm/bbp9981/dts/bindings/zmk,behavior-bt-clr.yaml
```yaml
# Copyright (c) 2025 ZitaoTech
# SPDX-License-Identifier: MIT

description: >
  Clear all Bluetooth bonds and flash backlight 5 times as confirmation.
  Uses the full-board backlight (zmk_keyboard_backlight chosen node) to
  rapidly blink 5 times, then restores the original brightness.

compatible: "zmk,behavior-bt-clr"

include: zero_param.yaml
```

## config/boards/arm/bbp9981/dts/bindings/zmk,behavior-mouse-key-press-swap.yaml
```yaml
description: Mouse key press/release with optional LCLK/RCLK swap

compatible: "zmk,behavior-mouse-key-press-swap"

properties:
  "#binding-cells":
    type: int
    required: true
    const: 1
  label:
    type: string
    required: false
    deprecated: true

binding-cells:
  - param1
```

## config/boards/arm/bbp9981/dts/bindings/zmk,behavior-sensor-gear.yaml
```yaml
description: Sensor gear behavior

compatible: "zmk,behavior-sensor-gear"

properties:
  "#binding-cells":
    type: int
    required: true
    const: 1
  label:
    type: string
    required: false
  gear-type:
    type: string
    required: true
    enum:
      - mouse
      - scroll
  min-gear:
    type: int
    required: true
  max-gear:
    type: int
    required: true

binding-cells:
  - gear
```

## config/boards/arm/bbp9981/dts/bindings/zmk,behavior-swap-buttons.yaml
```yaml
description: Button swap toggle for LCLK/RCLK

compatible: "zmk,behavior-swap-buttons"

properties:
  "#binding-cells":
    type: int
    required: true
    const: 0
  label:
    type: string
    required: false
```

## west.yml
```yaml
manifest:
  defaults:
    remote: zmkfirmware

  remotes:
    - name: zmkfirmware
      url-base: https://github.com/zmkfirmware

  projects:
    - name: zmk
      revision: main
```
